/*
 * CAUTION: This file is automatically generated by Xilinx.
 * Version:  
 * Today is: Sat Oct 18 22:56:34 2014
*/

/dts-v1/;
/include/ "ps.dtsi"
/include/ "pl.dtsi"
/{
	chosen {
		bootargs = "console=ttyPS0,115200 root=/dev/ram rw earlyprintk";
		linux,stdout-path = &ps7_uart_1;
	} ;
	aliases {
		ethernet0 = &ps7_ethernet_0;
		i2c0 = &ps7_i2c_0;
		serial0 = &ps7_uart_1;
		spi0 = &ps7_qspi_0;
	} ;
};
